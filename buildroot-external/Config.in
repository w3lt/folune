## buildroot-external/Config.in
```kconfig
menu "Folune"
    source "$BR2_EXTERNAL_FOLUNE_PATH/package/folune-app/Config.in"
    source "$BR2_EXTERNAL_FOLUNE_PATH/package/lvgl/Config.in"
endmenu
```

## buildroot-external/package/folune-app/Config.in
```kconfig
config BR2_PACKAGE_FOLUNE_APP
    bool "folune-app"
    depends on BR2_PACKAGE_HOST_RUSTC_TARGET_ARCH_SUPPORTS
    select BR2_PACKAGE_HOST_RUSTC
    help
      Folune's main userspace application.
```

## buildroot-external/package/folune-ui/Config.in
```kconfig
config BR2_PACKAGE_FOLUNE_UI
  bool "folune-ui"
  depends on BR2_INSTALL_LIBSTDCPP
  depends on BR2_TOOLCHAIN_HAS_THREADS
  select BR2_PACKAGE_LVGL
  help
    Folune's LVGL user interface

comment "folune-ui needs a toolchain w/ C++ and threads"
  depends on !BR2_INSTALL_LIBSTDCPP || !BR2_TOOLCHAIN_HAS_THREADS
```

## buildroot-external/package/lvgl/Config.in
```kconfig
config BR2_PACKAGE_LVGL
    bool "lvgl"
    depends on BR2_INSTALL_LIBSTDCPP
    depends on BR2_TOOLCHAIN_HAS_THREADS
    select BR2_PACKAGE_LIBDRM
    help
        LVGL is an embedded graphics library for creating graphical
        user interfaces.

        https://lvgl.io/

comment "lvgl needs a toolchain w/ C++ and threads"
    depends on !BR2_INSTALL_LIBSTDCPP || !BR2_TOOLCHAIN_HAS_THREADS
```
